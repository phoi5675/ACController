#include <IRremote.h>

// ir pin setup
IRsend irsend;
// ir vars
unsigned int turnOn[] = { 2996, 9012, 512, 1544, 512, 556, 520, 548, 516, 532, 488, 552, 484,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 1552, 404}; //AnalysIR Batch Export (IRremote) - RAW
unsigned int turnOff[] = {2956, 9064, 520, 1544, 520, 520, 556, 488, 516, 584, 576, 516, 516,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 1520, 492};
unsigned int turnHigh[] = {2964, 9036, 548, 1512, 564, 484, 548, 520, 528, 540, 564, 504, 528,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 1484, 552};

// selection var
char sel = 'a'; // select AC mode

void setup(){
  Serial.begin(9600);
}

void send_ir(char sel){
  Serial.println("sendir");
  int khz = 38; // 38kHz carrier frequency for the NEC protocol
  if(sel == '0'){ // turn off
    irsend.sendRaw(turnOff, sizeof(turnOff) / sizeof(turnOff[0]), khz);
  }
  else if(sel == '1') {// turn on
      Serial.println("1");
    irsend.sendRaw(turnOn, sizeof(turnOn) / sizeof(turnOn[0]), khz);
  }
  else if(sel == '2'){ // turn high
    irsend.sendRaw(turnHigh, sizeof(turnHigh) / sizeof(turnHigh[0]), khz);
  }
}
void loop() {

  // load val w/ uart
  if (Serial.available()){
    sel = (int)Serial.read();
    for(int i = 0; i < 3; i++){
      send_ir(sel);
      delay(500);
    }
    sel = 'a';
  }
  
  delay(1000);
}
